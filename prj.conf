## CMakeLists.txt
```
#
# Copyright (c) 2022 Nordic Semiconductor ASA
#
# SPDX-License-Identifier: LicenseRef-Nordic-5-Clause
#
cmake_minimum_required(VERSION 3.20.0)

find_package(Zephyr REQUIRED HINTS $ENV{ZEPHYR_BASE})
project(blerry_test)

FILE(GLOB app_sources src/*.c)
target_sources(app PRIVATE ${app_sources})

target_include_directories(app PRIVATE include)
# NORDIC SDK APP END
```

## prj.conf
```kconfig
#
# Copyright (c) 2022 Nordic Semiconductor ASA
#
# SPDX-License-Identifier: LicenseRef-Nordic-5-Clause
#
CONFIG_BT=y
CONFIG_BT_PERIPHERAL=y
CONFIG_BT_DEVICE_NAME="Blerry nRF temp"
CONFIG_BT_DEVICE_APPEARANCE=1344
CONFIG_BT_DEVICE_NAME_DYNAMIC=y

# CONFIG_BT_EXT_ADV=y

CONFIG_I2C=y
CONFIG_SENSOR=y
CONFIG_TMP112=y
```

## boards/nrf52840dongle_nrf52840.overlay
```dts
&i2c0 {
	#include "tmp112.dtsi"
};
```

## boards/nrf52_adafruit_feather.overlay
```dts
&feather_i2c {
	status = "okay";
	#include "tmp112.dtsi"
};
```

## boards/nrf52dk_nrf52832.overlay
```dts
&i2c0 {
	#include "tmp112.dtsi"
};
```

## boards/tmp112.dtsi
```dts
/*
 * Copyright (c) 2019, Linaro Ltd.
 *
 * SPDX-License-Identifier: Apache-2.0
 */

tmp112@48 {
    compatible = "ti,tmp112";
    reg = <0x48>;
    label = "TMP112";
};
```

## src/main.c
```c
/*
 * Copyright (c) 2022 Nordic Semiconductor ASA
 *
 * SPDX-License-Identifier: LicenseRef-Nordic-5-Clause
 */

#include <kernel.h>
#include <drivers/sensor.h>
#include <bluetooth/bluetooth.h>

#include "tmp112.h"

#define MANUF_LEN               9
#define THREAD_STACKSIZE        1024
#define THREAD_PRIORITY         7

#define DEVICE_NAME             CONFIG_BT_DEVICE_NAME
#define DEVICE_NAME_LEN         (sizeof(DEVICE_NAME) - 1)

static int32_t temperature;
K_MUTEX_DEFINE(temp_mutex);

K_THREAD_STACK_DEFINE(thread_tmp112_stack_area, THREAD_STACKSIZE);
static struct k_thread thread_tmp112_data;

#define ADV_PARAM BT_LE_ADV_PARAM(BT_LE_ADV_OPT_USE_IDENTITY, \
					     BT_GAP_ADV_SLOW_INT_MIN, \
					     BT_GAP_ADV_SLOW_INT_MAX, NULL)

static uint8_t manuf_data[MANUF_LEN] = { 
	0x00,
	0x00,
	0x00,
	0x00,
	0x00,
	0x00,
	0x00,
	0x00,
	0x00,
};

static struct bt_data ad[] = {
	BT_DATA_BYTES(BT_DATA_FLAGS, BT_LE_AD_GENERAL | BT_LE_AD_NO_BREDR),
	BT_DATA(BT_DATA_NAME_COMPLETE, DEVICE_NAME, DEVICE_NAME_LEN),
	BT_DATA(BT_DATA_MANUFACTURER_DATA, manuf_data, MANUF_LEN)
};

static void bt_ready(int err)
{
	if (err) {
		printk("Bluetooth init failed (err %d)\n", err);
		return;
	}

	printk("Bluetooth initialized\n");

	/* Start advertising */
	err = bt_le_adv_start(ADV_PARAM, ad, ARRAY_SIZE(ad), NULL, 0);
	if (err) {
		printk("Advertising failed to start (err %d)\n", err);
		return;
	}
}

void main(void)
{
	int err;

	printk("Starting Blerry test\n");

	const struct device *dev = DEVICE_DT_GET_ANY(ti_tmp112);

	__ASSERT(dev != NULL, "Failed to get device binding");
	__ASSERT(device_is_ready(dev), "Device %s is not ready", dev->name);
	printk("device is %p, name is %s\n", dev, dev->name);

	k_thread_create(&thread_tmp112_data, thread_tmp112_stack_area,
			K_THREAD_STACK_SIZEOF(thread_tmp112_stack_area),
			thread_tmp112, (void *)dev, (void *)&temp_mutex, (void*)&temperature,
			THREAD_PRIORITY, 0, K_FOREVER);
	k_thread_start(&thread_tmp112_data);

	/* Initialize the Bluetooth Subsystem */
	err = bt_enable(bt_ready);
	if (err) {
		printk("Bluetooth init failed (err %d)\n", err);
	}
	printk("Bluetooth initialized\n");

	for (;;) {
		if (k_mutex_lock(&temp_mutex, K_MSEC(100)) == 0) {
			manuf_data[0] = (uint8_t)((uint32_t)temperature & 0xff);
			manuf_data[1] = (uint8_t)(((uint32_t)temperature >> 8) & 0xff);
			k_mutex_unlock(&temp_mutex);
		}
		err = bt_le_adv_update_data(ad, ARRAY_SIZE(ad), NULL, 0);
		if (err) {
			printk("Failed to update advertising data (err %d)\n", err);
		}
		k_sleep(K_MSEC(BT_GAP_ADV_SLOW_INT_MIN));
	}
}
```

## include/tmp112.h
```c
void thread_tmp112(void *p1, void *dummy1, void *dummy2);
```

## src/tmp112.c
```c
/*
 * Copyright (c) 2016 Firmwave
 *
 * SPDX-License-Identifier: Apache-2.0
 */

#include <zephyr.h>
#include <drivers/sensor.h>

void thread_tmp112(void *p1, void *p2, void *p3)
{
	int ret;
	struct sensor_value temp_value;
	struct sensor_value attr;

	const struct device *dev = (const struct device *)p1;
	struct k_mutex *temp_mutex = (struct k_mutex *)p2;
	int32_t *temp = (int32_t *)p3;

	attr.val1 = 150;
	attr.val2 = 0;
	ret = sensor_attr_set(dev, SENSOR_CHAN_AMBIENT_TEMP,
			      SENSOR_ATTR_FULL_SCALE, &attr);
	if (ret) {
		printk("sensor_attr_set failed ret %d\n", ret);
		return;
	}

	attr.val1 = 8;
	attr.val2 = 0;
	ret = sensor_attr_set(dev, SENSOR_CHAN_AMBIENT_TEMP,
			      SENSOR_ATTR_SAMPLING_FREQUENCY, &attr);
	if (ret) {
		printk("sensor_attr_set failed ret %d\n", ret);
		return;
	}

	while (1) {
		ret = sensor_sample_fetch(dev);
		if (ret) {
			printk("sensor_sample_fetch failed ret %d\n", ret);
			return;
		}

		ret = sensor_channel_get(dev, SENSOR_CHAN_AMBIENT_TEMP, &temp_value);
		if (ret) {
			printk("sensor_channel_get failed ret %d\n", ret);
			return;
		}
		if (k_mutex_lock(temp_mutex, K_MSEC(2000)) == 0) {
			*temp = temp_value.val1 * 1E6 + temp_value.val2;
			float ftemp = (*temp + 5000)/10000.0;
			*temp = ftemp;
			k_mutex_unlock(temp_mutex);
		} else {
			printk("Unable to lock mutex\n");
		}
		k_sleep(K_MSEC(2000));
	}
}
```
